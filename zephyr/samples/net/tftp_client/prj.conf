## sample.yaml
```
sample:
  description: Test TFTP client get and put methods
  name: TFTP client sample app
tests:
  sample.net.tftp_client:
    harness: net
    depends_on: netif
    platform_allow:
      - native_posix
    integration_platforms:
      - native_posix
    tags:
      - net
      - tftp
```

## prj.conf
```kconfig
CONFIG_NETWORKING=y
CONFIG_LOG=y
CONFIG_NET_IPV4=y
CONFIG_NET_IPV6=y
CONFIG_NET_PKT_RX_COUNT=10
CONFIG_NET_PKT_TX_COUNT=10
CONFIG_NET_BUF_RX_COUNT=10
CONFIG_NET_BUF_TX_COUNT=10
CONFIG_NET_MAX_CONTEXTS=2

CONFIG_NET_LOG=y

CONFIG_NET_CONFIG_SETTINGS=y
CONFIG_NET_CONFIG_NEED_IPV6=y
CONFIG_NET_CONFIG_MY_IPV6_ADDR="2001:db8::1"
CONFIG_NET_CONFIG_NEED_IPV4=y
CONFIG_NET_CONFIG_MY_IPV4_ADDR="192.0.2.1"

CONFIG_DNS_RESOLVER=n
CONFIG_TFTP_LIB=y
```

## src/tftp-client.c
```c
/*
 * Copyright (c) 2023 Kickmaker
 *
 * SPDX-License-Identifier: Apache-2.0
 */

#define LOG_MODULE_NAME net_tftp_client_app
#define LOG_LEVEL LOG_LEVEL_DBG

#include <zephyr/logging/log.h>
LOG_MODULE_REGISTER(LOG_MODULE_NAME);

#include <zephyr/net/tftp.h>

#define APP_BANNER		"Run TFTP client"
#define TFTP_SAMPLE_DATA	"Lorem ipsum dolor sit amet, consectetur adipiscing elit"

static struct tftpc client;

static void tftp_event_callback(const struct tftp_evt *evt)
{
	switch (evt->type) {
	case TFTP_EVT_DATA:
		LOG_HEXDUMP_INF(evt->param.data.data_ptr,
				evt->param.data.len,
				"Received data: ");
		break;
	case TFTP_EVT_ERROR:
		LOG_ERR("Error code %d msg: %s",
			evt->param.error.code,
			evt->param.error.msg);
	default:
		break;
	}
}

static int tftp_init(const char *hostname)
{
	struct sockaddr remote_addr;
	struct zsock_addrinfo *res, hints = {0};
	int ret;

	/* Setup TFTP server address */
	hints.ai_socktype = SOCK_DGRAM;

	ret = zsock_getaddrinfo(hostname, CONFIG_TFTP_APP_PORT, &hints, &res);
	if (ret != 0) {
		LOG_ERR("Unable to resolve address");
		/* DNS error codes don't align with normal errors */
		return -ENOENT;
	}

	memcpy(&remote_addr, res->ai_addr, sizeof(remote_addr));
	zsock_freeaddrinfo(res);

	/* Save sockaddr into TFTP client handler */
	memcpy(&client.server, &remote_addr, sizeof(client.server));
	/* Register TFTP client callback */
	client.callback = tftp_event_callback;

	return 0;
}

int main(void)
{
	int ret;

	LOG_INF(APP_BANNER);

	ret = tftp_init(CONFIG_TFTP_APP_SERVER);
	if (ret < 0) {
		LOG_ERR("Unable to initialize TFTP client");
		return ret;
	}

	/* Get file1.bin in octet mode */
	ret = tftp_get(&client, "file1.bin", "octet");
	if (ret < 0) {
		LOG_ERR("Error while getting file (%d)", ret);
		return ret;
	}

	LOG_INF("TFTP client get done");

	/* Put TFTP sample data into newfile.bin to server in octet mode */
	ret = tftp_put(&client, "newfile.bin", "octet",
			TFTP_SAMPLE_DATA, sizeof(TFTP_SAMPLE_DATA));
	if (ret < 0 || ret != sizeof(TFTP_SAMPLE_DATA)) {
		LOG_ERR("Error while putting file (%d)", ret);
		return ret;
	}

	LOG_INF("TFTP client put done");

	return 0;
}
```
