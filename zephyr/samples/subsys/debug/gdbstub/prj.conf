## CMakeLists.txt
```
# SPDX-License-Identifier: Apache-2.0

cmake_minimum_required(VERSION 3.20.0)

if(BOARD MATCHES "qemu_x86")
  list(APPEND QEMU_EXTRA_FLAGS -serial tcp:127.0.0.1:5678,server)
endif()

find_package(Zephyr REQUIRED HINTS $ENV{ZEPHYR_BASE})
project(debug)

target_sources(app PRIVATE src/main.c)
```

## sample.yaml
```
#
# Copyright (c) 2020 intel Corporation.
#
# SPDX-License-Identifier: Apache-2.0
#

sample:
  name: gdbstub sample
tests:
  sample.debug.gdbstub:
    build_only: true
    platform_allow: qemu_x86
    tags:
      - debug
      - gdbstub
```

## prj.conf
```kconfig
CONFIG_GDBSTUB=y
CONFIG_NO_OPTIMIZATIONS=y
CONFIG_USERSPACE=y
CONFIG_KOBJECT_TEXT_AREA=4096
```

## src/main.c
```c
/*
 * Copyright (c) 2020 Intel Corporation.
 *
 * SPDX-License-Identifier: Apache-2.0
 */

#include <zephyr/kernel.h>
#include <zephyr/sys/printk.h>

#define STACKSIZE 512

static int test(void)
{
	int a;
	int b;

	a = 10;
	b = a * 2;

	return a + b;
}

static void thread_entry(void *p1, void *p2, void *p3)
{
	printk("Hello from user thread!\n");
}

int main(void)
{
	int ret;

	ret = test();
	printk("%d\n", ret);
	return 0;
}

K_THREAD_DEFINE(thread, STACKSIZE, thread_entry, NULL, NULL, NULL,
		7, K_USER, 0);
```
