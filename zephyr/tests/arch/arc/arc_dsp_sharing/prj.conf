## prj.conf
```kconfig
CONFIG_ZTEST=y
CONFIG_ZTEST_NEW_API=y
CONFIG_ARC_DSP=y
CONFIG_ARC_DSP_SHARING=y
CONFIG_MAIN_STACK_SIZE=1024
CONFIG_ARC_DSP_BFLY_SHARING=y
```

## src/main.c
```c
/*
 * Copyright (c) 2022 Synopsys
 *
 * SPDX-License-Identifier: Apache-2.0
 */

#include <zephyr/ztest.h>
#include "test_common.h"

#ifndef CONFIG_ARC_DSP
#error Rebuild with the ARC_DSP config option enabled
#endif

#ifndef CONFIG_ARC_DSP_SHARING
#error Rebuild with the ARC_DSP_SHARING config option enabled
#endif

static void *generic_setup(void)
{
	/*
	 * Enable round robin scheduling to allow both the low priority complex
	 * computation and load/store tasks to execute. The high priority complex
	 * computation and load/store tasks will preempt the low priority tasks
	 * periodically.
	 */
	k_sched_time_slice_set(10, THREAD_LOW_PRIORITY);

	return NULL;
}

ZTEST_SUITE(dsp_sharing, NULL, generic_setup, NULL, NULL, NULL);
```

## src/test_common.h
```c
/*
 * Copyright (c) 2022 Synopsys
 *
 * SPDX-License-Identifier: Apache-2.0
 */

#define MAX_TESTS	500

/*
 * Test Thread Parameters
 */
#define THREAD_STACK_SIZE	(1024 + CONFIG_TEST_EXTRA_STACK_SIZE)

#define THREAD_HIGH_PRIORITY	5
#define THREAD_LOW_PRIORITY	10

#define THREAD_DSP_FLAGS		(K_ARC_DSP_REGS | K_ARC_AGU_REGS)
```
