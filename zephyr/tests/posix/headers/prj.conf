## CMakeLists.txt
```
# SPDX-License-Identifier: Apache-2.0

cmake_minimum_required(VERSION 3.20.0)
find_package(Zephyr REQUIRED HINTS $ENV{ZEPHYR_BASE})
project(posix_headers)

FILE(GLOB app_sources src/*.c)
target_sources(app PRIVATE ${app_sources})
```

## prj.conf
```kconfig
CONFIG_POSIX_API=y
CONFIG_ZTEST=y
CONFIG_ZTEST_NEW_API=y

# for POSIX_FS
CONFIG_FILE_SYSTEM=y

# for select to work
CONFIG_NET_TEST=y
CONFIG_TEST_RANDOM_GENERATOR=y
CONFIG_NET_SOCKETS=y
CONFIG_NETWORKING=y

# for when CONFIG_POSIX_API is not selected
CONFIG_PTHREAD_IPC=y
CONFIG_POSIX_FS=y
CONFIG_POSIX_CLOCK=y
CONFIG_POSIX_MQUEUE=y
CONFIG_EVENTFD=y
CONFIG_GETOPT=y
```

## src/arpa_inet_h.c
```c
/*
 * Copyright (c) 2022 Meta
 *
 * SPDX-License-Identifier: Apache-2.0
 */

#include "_common.h"

#ifdef CONFIG_POSIX_API
#include <arpa/inet.h>
#else
#include <zephyr/posix/arpa/inet.h>
#endif

/**
 * @brief existence test for `<arpa/inet.h>`
 *
 * @see <a href="https://pubs.opengroup.org/onlinepubs/9699919799/basedefs/arpa_inet.h.html">arpa/inet.h</a>
 */
ZTEST(posix_headers, test_arpa_inet_h)
{
	zassert_not_equal(-1, htonl(0));
	zassert_not_equal(-1, htons(0));
	zassert_not_equal(-1, ntohl(0));
	zassert_not_equal(-1, ntohs(0));

	if (IS_ENABLED(CONFIG_POSIX_API)) {
		/* zassert_not_null(inet_addr); */ /* not implemented */
		/* zassert_not_null(inet_ntoa); */ /* not implemented */
		zassert_not_null(inet_ntop);
		zassert_not_null(inet_pton);
	}
}
```

## src/dirent_h.c
```c
/*
 * Copyright (c) 2022 Meta
 *
 * SPDX-License-Identifier: Apache-2.0
 */

#include "_common.h"

#ifdef CONFIG_POSIX_API
#include <dirent.h>
#else
#include <zephyr/posix/dirent.h>
#endif

/**
 * @brief existence test for `<dirent.h>`
 *
 * @see <a href="https://pubs.opengroup.org/onlinepubs/9699919799/basedefs/dirent.h.html">dirent.h</a>
 */
ZTEST(posix_headers, test_dirent_h)
{
	zassert_not_equal((DIR *)-1, (DIR *)NULL);

	zassert_not_equal(-1, offsetof(struct dirent, d_ino));
	zassert_not_equal(-1, offsetof(struct dirent, d_name));

	if (IS_ENABLED(CONFIG_POSIX_API)) {
		/* zassert_not_null(alphasort); */ /* not implemented */
		zassert_not_null(closedir);
		/* zassert_not_null(dirfd); */ /* not implemented */
		/* zassert_not_null(fdopendir); */ /* not implemented */
		zassert_not_null(opendir);
		zassert_not_null(readdir);
		/* zassert_not_null(readdir_r); */ /* not implemented */
		/* zassert_not_null(rewinddir); */ /* not implemented */
		/* zassert_not_null(scandir); */ /* not implemented */
		/* zassert_not_null(seekdir); */ /* not implemented */
		/* zassert_not_null(telldir); */ /* not implemented */
	}
}
```

## src/mqueue_h.c
```c
/*
 * Copyright (c) 2022 Meta
 *
 * SPDX-License-Identifier: Apache-2.0
 */

#include "_common.h"

#ifdef CONFIG_POSIX_API
#include <mqueue.h>
#else
#include <zephyr/posix/mqueue.h>
#endif

/**
 * @brief existence test for `<mqueue.h>`
 *
 * @see <a href="https://pubs.opengroup.org/onlinepubs/9699919799/basedefs/mqueue.h.html">mqueue.h</a>
 */
ZTEST(posix_headers, test_mqueue_h)
{
	zassert_not_equal((mqd_t)-1, (mqd_t)NULL);

	zassert_not_equal(-1, offsetof(struct mq_attr, mq_flags));
	zassert_not_equal(-1, offsetof(struct mq_attr, mq_maxmsg));
	zassert_not_equal(-1, offsetof(struct mq_attr, mq_msgsize));
	zassert_not_equal(-1, offsetof(struct mq_attr, mq_curmsgs));

	if (IS_ENABLED(CONFIG_POSIX_API)) {
		zassert_not_null(mq_close);
		zassert_not_null(mq_getattr);
		/* zassert_not_null(mq_notify); */ /* not implemented */
		zassert_not_null(mq_open);
		zassert_not_null(mq_receive);
		zassert_not_null(mq_send);
		zassert_not_null(mq_setattr);
		zassert_not_null(mq_timedreceive);
		zassert_not_null(mq_timedsend);
		zassert_not_null(mq_unlink);
	}
}
```

## src/net_if_h.c
```c
/*
 * Copyright (c) 2022 Meta
 *
 * SPDX-License-Identifier: Apache-2.0
 */

#include "_common.h"

#ifdef CONFIG_POSIX_API
#include <net/if.h>
#else
#include <zephyr/posix/net/if.h>
#endif

/**
 * @brief existence test for `<net/if.h>`
 *
 * @see <a href="https://pubs.opengroup.org/onlinepubs/9699919799/basedefs/net_if.h.html">net/if.h</a>
 */
ZTEST(posix_headers, test_net_if_h)
{
	/* zassert_not_equal(-1, offsetof(struct if_nameindex, if_index)); */ /* not implemented */
	/* zassert_not_equal(-1, offsetof(struct if_nameindex, if_name)); */ /* not implemented */

	/* zassert_not_equal(-1, IF_NAMESIZE); */ /* not implemented */

	if (IS_ENABLED(CONFIG_POSIX_API)) {
		/* zassert_not_null(if_freenameindex); */ /* not implemented */
		/* zassert_not_null(if_indextoname); */ /* not implemented */
		/* zassert_not_null(if_nameindex); */ /* not implemented */
		/* zassert_not_null(if_nametoindex); */ /* not implemented */
	}
}
```

## src/netdb_h.c
```c
/*
 * Copyright (c) 2022 Meta
 *
 * SPDX-License-Identifier: Apache-2.0
 */

#include "_common.h"

#ifdef CONFIG_POSIX_API
#include <netdb.h>
#else
#include <zephyr/posix/netdb.h>
#endif

/**
 * @brief existence test for `<netdb.h>`
 *
 * @see <a href="https://pubs.opengroup.org/onlinepubs/9699919799/basedefs/netdb.h.html>netdb.h</a>
 */
ZTEST(posix_headers, test_netdb_h)
{
	/* zassert_not_equal(-1, offsetof(struct hostent, h_name)); */ /* not implemented */
	/* zassert_not_equal(-1, offsetof(struct hostent, h_aliases)); */ /* not implemented */
	/* zassert_not_equal(-1, offsetof(struct hostent, h_addrtype)); */ /* not implemented */
	/* zassert_not_equal(-1, offsetof(struct hostent, h_length)); */ /* not implemented */
	/* zassert_not_equal(-1, offsetof(struct hostent, h_addr_list)); */ /* not implemented */

	/* zassert_not_equal(-1, offsetof(struct netent, n_name)); */ /* not implemented */
	/* zassert_not_equal(-1, offsetof(struct netent, n_aliases)); */ /* not implemented */
	/* zassert_not_equal(-1, offsetof(struct netent, n_addrtype)); */ /* not implemented */
	/* zassert_not_equal(-1, offsetof(struct netent, n_net)); */ /* not implemented */

	/* zassert_not_equal(-1, offsetof(struct protoent, p_name)); */ /* not implemented */
	/* zassert_not_equal(-1, offsetof(struct protoent, p_aliases)); */ /* not implemented */
	/* zassert_not_equal(-1, offsetof(struct protoent, p_proto)); */ /* not implemented */

	/* zassert_not_equal(-1, offsetof(struct servent, s_name)); */ /* not implemented */
	/* zassert_not_equal(-1, offsetof(struct servent, s_aliases)); */ /* not implemented */
	/* zassert_not_equal(-1, offsetof(struct servent, s_port)); */ /* not implemented */
	/* zassert_not_equal(-1, offsetof(struct servent, s_proto)); */ /* not implemented */

	/* zassert_equal(IPPORT_RESERVED, UINT16_MAX); */ /* not implemented */

	zassert_not_equal(-1, offsetof(struct addrinfo, ai_flags));
	zassert_not_equal(-1, offsetof(struct addrinfo, ai_family));
	zassert_not_equal(-1, offsetof(struct addrinfo, ai_socktype));
	zassert_not_equal(-1, offsetof(struct addrinfo, ai_protocol));
	zassert_not_equal(-1, offsetof(struct addrinfo, ai_addrlen));
	zassert_not_equal(-1, offsetof(struct addrinfo, ai_addr));
	zassert_not_equal(-1, offsetof(struct addrinfo, ai_canonname));
	zassert_not_equal(-1, offsetof(struct addrinfo, ai_next));

	zassert_not_equal(-1, AI_PASSIVE);
	zassert_not_equal(-1, AI_CANONNAME);
	zassert_not_equal(-1, AI_NUMERICHOST);
	zassert_not_equal(-1, AI_NUMERICSERV);
	zassert_not_equal(-1, AI_V4MAPPED);
	zassert_not_equal(-1, AI_ALL);
	zassert_not_equal(-1, AI_ADDRCONFIG);

	zassert_not_equal(-1, NI_NOFQDN);
	zassert_not_equal(-1, NI_NUMERICHOST);
	zassert_not_equal(-1, NI_NAMEREQD);
	zassert_not_equal(-1, NI_NUMERICSERV);
	/* zassert_not_equal(-1, NI_NUMERICSCOPE); */ /* not implemented */
	zassert_not_equal(-1, NI_DGRAM);

	zassert_not_equal(-1, EAI_AGAIN);
	zassert_equal(-1, EAI_BADFLAGS);
	zassert_not_equal(-1, EAI_FAIL);
	zassert_not_equal(-1, EAI_FAMILY);
	zassert_not_equal(-1, EAI_MEMORY);
	zassert_not_equal(-1, EAI_NONAME);
	zassert_not_equal(-1, EAI_SERVICE);
	zassert_not_equal(-1, EAI_SOCKTYPE);
	zassert_not_equal(-1, EAI_SYSTEM);
	zassert_not_equal(-1, EAI_OVERFLOW);

	if (IS_ENABLED(CONFIG_POSIX_API)) {
		/* zassert_not_null(endhostent); */ /* not implemented */
		/* zassert_not_null(endnetent); */ /* not implemented */
		/* zassert_not_null(endprotoent); */ /* not implemented */
		/* zassert_not_null(endservent); */ /* not implemented */
		zassert_not_null(freeaddrinfo);
		zassert_not_null(gai_strerror);
		zassert_not_null(getaddrinfo);
		/* zassert_not_null(gethostent); */ /* not implemented */
		zassert_not_null(getnameinfo);
		/* zassert_not_null(getnetbyaddr); */ /* not implemented */
		/* zassert_not_null(getnetbyname); */ /* not implemented */
		/* zassert_not_null(getnetent); */ /* not implemented */
		/* zassert_not_null(getprotobyname); */ /* not implemented */
		/* zassert_not_null(getprotobynumber); */ /* not implemented */
		/* zassert_not_null(getprotoent); */ /* not implemented */
		/* zassert_not_null(getservbyname); */ /* not implemented */
		/* zassert_not_null(getservbyport); */ /* not implemented */
		/* zassert_not_null(getservent); */ /* not implemented */
		/* zassert_not_null(sethostent); */ /* not implemented */
		/* zassert_not_null(setnetent); */ /* not implemented */
		/* zassert_not_null(setprotoent); */ /* not implemented */
		/* zassert_not_null(setservent); */ /* not implemented */
	}
}
```

## src/poll_h.c
```c
/*
 * Copyright (c) 2022 Meta
 *
 * SPDX-License-Identifier: Apache-2.0
 */

#include "_common.h"

#ifdef CONFIG_POSIX_API
#include <poll.h>
#else
#include <zephyr/posix/poll.h>
#endif

/**
 * @brief existence test for `<poll.h>`
 *
 * @see <a href="https://pubs.opengroup.org/onlinepubs/9699919799/basedefs/poll.h.html">poll.h</a>
 */
ZTEST(posix_headers, test_poll_h)
{
	zassert_not_equal(-1, offsetof(struct pollfd, fd));
	zassert_not_equal(-1, offsetof(struct pollfd, events));
	zassert_not_equal(-1, offsetof(struct pollfd, revents));

	/* zassert_true(sizeof(nfds_t) <= sizeof(long)); */ /* not implemented */

	zassert_not_equal(-1, POLLIN);
	/* zassert_not_equal(-1, POLLRDNORM); */ /* not implemented */
	/* zassert_not_equal(-1, POLLRDBAND); */ /* not implemented */
	/* zassert_not_equal(-1, POLLPRI); */ /* not implemented */
	zassert_not_equal(-1, POLLOUT);
	/* zassert_not_equal(-1, POLLWRNORM); */ /* not implemented */
	/* zassert_not_equal(-1, POLLWRBAND); */ /* not implemented */
	zassert_not_equal(-1, POLLERR);
	zassert_not_equal(-1, POLLHUP);
	zassert_not_equal(-1, POLLNVAL);

	if (IS_ENABLED(CONFIG_POSIX_API)) {
		zassert_not_null(poll);
	}
}
```

## src/pthread_h.c
```c
/*
 * Copyright (c) 2022 Meta
 *
 * SPDX-License-Identifier: Apache-2.0
 */

#include "_common.h"

#ifdef CONFIG_POSIX_API
#include <pthread.h>
#else
#include <zephyr/posix/pthread.h>
#endif

#pragma GCC diagnostic push
#pragma GCC diagnostic ignored "-Wunused-variable"
/**
 * @brief existence test for `<pthread.h>`
 *
 * @see <a href="https://pubs.opengroup.org/onlinepubs/9699919799/basedefs/pthread.h.html">pthread.h</a>
 */
ZTEST(posix_headers, test_pthread_h)
{
	zassert_not_equal(-1, PTHREAD_BARRIER_SERIAL_THREAD);

	/* zassert_not_equal(-1, PTHREAD_CANCEL_ASYNCHRONOUS); */ /* not implemented */
	zassert_not_equal(-1, PTHREAD_CANCEL_ENABLE);
	/* zassert_not_equal(-1, PTHREAD_CANCEL_DEFERRED); */ /* not implemented */
	zassert_not_equal(-1, PTHREAD_CANCEL_DISABLE);

	/* zassert_not_equal(-1, PTHREAD_CANCELED); */ /* not implemented */

	zassert_not_equal(-1, PTHREAD_CREATE_DETACHED);
	zassert_not_equal(-1, PTHREAD_CREATE_JOINABLE);

	/* zassert_not_equal(-1, PTHREAD_EXPLICIT_SCHED); */ /* not implemented */
	/* zassert_not_equal(-1, PTHREAD_INHERIT_SCHED); */ /* not implemented */

	zassert_not_equal(-1, PTHREAD_MUTEX_DEFAULT);
	zassert_not_equal(-1, PTHREAD_MUTEX_ERRORCHECK);
	zassert_not_equal(-1, PTHREAD_MUTEX_ERRORCHECK);
	zassert_not_equal(-1, PTHREAD_MUTEX_RECURSIVE);
	/* zassert_not_equal(-1, PTHREAD_MUTEX_ROBUST); */ /* not implemented */
	/* zassert_not_equal(-1, PTHREAD_MUTEX_STALLED); */ /* not implemented */

	pthread_once_t once = PTHREAD_ONCE_INIT;

	/* zassert_not_equal(-1, PTHREAD_PRIO_INHERIT); */ /* not implemented */
	zassert_not_equal(-1, PTHREAD_PRIO_NONE);
	/* zassert_not_equal(-1, PTHREAD_PRIO_PROTECT); */ /* not implemented */

	/* zassert_not_equal(-1, PTHREAD_PROCESS_SHARED); */ /* not implemented */
	/* zassert_not_equal(-1, PTHREAD_PROCESS_PRIVATE); */ /* not implemented */

	/* zassert_not_equal(-1, PTHREAD_SCOPE_PROCESS); */ /* not implemented */
	/* zassert_not_equal(-1, PTHREAD_SCOPE_SYSTEM); */ /* not implemented */

	/* pthread_cond_t cond = PTHREAD_COND_INITIALIZER; */ /* not implemented */
	/* pthread_mutex_t mu = PTHREAD_MUTEX_INITIALIZER; */ /* not implemented */
	/* pthread_rwlock_t lock = PTHREAD_RWLOCK_INITIALIZER; */ /* not implemented */

	if (IS_ENABLED(CONFIG_POSIX_API)) {
		/* zassert_not_null(pthread_atfork); */ /* not implemented */
		zassert_not_null(pthread_attr_destroy);
		zassert_not_null(pthread_attr_getdetachstate);
		/* zassert_not_null(pthread_attr_getguardsize); */ /* not implemented */
		/* zassert_not_null(pthread_attr_getinheritsched); */ /* not implemented */
		zassert_not_null(pthread_attr_getschedparam);
		zassert_not_null(pthread_attr_getschedpolicy);
		/* zassert_not_null(pthread_attr_getscope); */ /* not implemented */
		zassert_not_null(pthread_attr_getstack);
		zassert_not_null(pthread_attr_getstacksize);
		zassert_not_null(pthread_attr_init);
		zassert_not_null(pthread_attr_setdetachstate);
		/* zassert_not_null(pthread_attr_setguardsize); */ /* not implemented */
		/* zassert_not_null(pthread_attr_setinheritsched); */ /* not implemented */
		zassert_not_null(pthread_attr_setschedparam);
		zassert_not_null(pthread_attr_setschedpolicy);
		/* zassert_not_null(pthread_attr_setscope); */ /* not implemented */
		zassert_not_null(pthread_attr_setstack);
		zassert_not_null(pthread_attr_setstacksize);
		zassert_not_null(pthread_barrier_destroy);
		zassert_not_null(pthread_barrier_init);
		zassert_not_null(pthread_barrier_wait);
		zassert_not_null(pthread_barrierattr_destroy);
		/* zassert_not_null(pthread_barrierattr_getpshared); */ /* not implemented */
		zassert_not_null(pthread_barrierattr_init);
		/* zassert_not_null(pthread_barrierattr_setpshared); */ /* not implemented */
		zassert_not_null(pthread_cancel);
		zassert_not_null(pthread_cond_broadcast);
		zassert_not_null(pthread_cond_destroy);
		zassert_not_null(pthread_cond_init);
		zassert_not_null(pthread_cond_signal);
		zassert_not_null(pthread_cond_timedwait);
		zassert_not_null(pthread_cond_wait);
		zassert_not_null(pthread_condattr_destroy);
		/* zassert_not_null(pthread_condattr_getclock); */ /* not implemented */
		/* zassert_not_null(pthread_condattr_getpshared); */ /* not implemented */
		zassert_not_null(pthread_condattr_init);
		/* zassert_not_null(pthread_condattr_setclock); */ /* not implemented */
		/* zassert_not_null(pthread_condattr_setpshared); */ /* not implemented */
		zassert_not_null(pthread_create);
		zassert_not_null(pthread_detach);
		zassert_not_null(pthread_equal);
		zassert_not_null(pthread_exit);
		/* zassert_not_null(pthread_getconcurrency); */ /* not implemented */
		/* zassert_not_null(pthread_getcpuclockid); */ /* not implemented */
		zassert_not_null(pthread_getschedparam);
		zassert_not_null(pthread_getspecific);
		zassert_not_null(pthread_join);
		zassert_not_null(pthread_key_create);
		zassert_not_null(pthread_key_delete);
		/* zassert_not_null(pthread_mutex_consistent); */ /* not implemented */
		zassert_not_null(pthread_mutex_destroy);
		/* zassert_not_null(pthread_mutex_getprioceiling); */ /* not implemented */
		zassert_not_null(pthread_mutex_init);
		zassert_not_null(pthread_mutex_lock);
		/* zassert_not_null(pthread_mutex_setprioceiling); */ /* not implemented */
		zassert_not_null(pthread_mutex_timedlock);
		zassert_not_null(pthread_mutex_trylock);
		zassert_not_null(pthread_mutex_unlock);
		zassert_not_null(pthread_mutexattr_destroy);
		/* zassert_not_null(pthread_mutexattr_getprioceiling); */ /* not implemented */
		zassert_not_null(pthread_mutexattr_getprotocol);
		/* zassert_not_null(pthread_mutexattr_getpshared); */ /* not implemented */
		/* zassert_not_null(pthread_mutexattr_getrobust); */ /* not implemented */
		zassert_not_null(pthread_mutexattr_gettype);
		zassert_not_null(pthread_mutexattr_init);
		/* zassert_not_null(pthread_mutexattr_setprioceiling); */ /* not implemented */
		/* zassert_not_null(pthread_mutexattr_setprotocol); */ /* not implemented */
		/* zassert_not_null(pthread_mutexattr_setpshared); */ /* not implemented */
		/* zassert_not_null(pthread_mutexattr_setrobust); */ /* not implemented */
		zassert_not_null(pthread_mutexattr_settype);
		zassert_not_null(pthread_once);
		zassert_not_null(pthread_rwlock_destroy);
		zassert_not_null(pthread_rwlock_init);
		zassert_not_null(pthread_rwlock_rdlock);
		zassert_not_null(pthread_rwlock_timedrdlock);
		zassert_not_null(pthread_rwlock_timedwrlock);
		zassert_not_null(pthread_rwlock_tryrdlock);
		zassert_not_null(pthread_rwlock_trywrlock);
		zassert_not_null(pthread_rwlock_unlock);
		zassert_not_null(pthread_rwlock_wrlock);
		zassert_not_null(pthread_rwlockattr_destroy);
		/* zassert_not_null(pthread_rwlockattr_getpshared); */ /* not implemented */
		zassert_not_null(pthread_rwlockattr_init);
		/* zassert_not_null(pthread_rwlockattr_setpshared); */ /* not implemented */
		zassert_not_null(pthread_self);
		/* zassert_not_null(pthread_setcancelstate); */ /* not implemented */
		/* zassert_not_null(pthread_setcanceltype); */ /* not implemented */
		/* zassert_not_null(pthread_setconcurrency); */ /* not implemented */
		zassert_not_null(pthread_setschedparam);
		/* zassert_not_null(pthread_setschedprio); */ /* not implemented */
		zassert_not_null(pthread_setspecific);
		/* zassert_not_null(pthread_spin_destroy); */ /* not implemented */
		/* zassert_not_null(pthread_spin_init); */ /* not implemented */
		/* zassert_not_null(pthread_spin_lock); */ /* not implemented */
		/* zassert_not_null(pthread_spin_unlock); */ /* not implemented */
		/* zassert_not_null(pthread_testcancel); */ /* not implemented */
	}
}
#pragma GCC diagnostic pop
```

## src/sched_h.c
```c
/*
 * Copyright (c) 2022 Meta
 *
 * SPDX-License-Identifier: Apache-2.0
 */

#include "_common.h"

#ifdef CONFIG_POSIX_API
#include <sched.h>
#else
#include <zephyr/posix/sched.h>
#endif

/**
 * @brief existence test for `<sched.h>`
 *
 * @see <a href="https://pubs.opengroup.org/onlinepubs/9699919799/basedefs/sched.h.html">sched.h</a>
 */
ZTEST(posix_headers, test_sched_h)
{
	zassert_not_equal(-1, offsetof(struct sched_param, sched_priority));

	zassert_not_equal(-1, SCHED_FIFO);
	zassert_not_equal(-1, SCHED_RR);
	/* zassert_not_equal(-1, SCHED_SPORADIC); */ /* not implemented */
	/* zassert_not_equal(-1, SCHED_OTHER); */ /* not implemented */

	if (IS_ENABLED(CONFIG_POSIX_API)) {
		zassert_not_null(sched_get_priority_max);
		zassert_not_null(sched_get_priority_min);

		/* zassert_not_null(sched_getparam); */ /* not implemented */
		/* zassert_not_null(sched_getscheduler); */ /* not implemented */

		/* zassert_not_null(sched_rr_get_interval); */ /* not implemented */

		/* zassert_not_null(sched_setparam); */ /* not implemented */
		/* zassert_not_null(sched_setscheduler); */ /* not implemented */

		zassert_not_null(sched_yield);
	}
}
```

## src/semaphore_h.c
```c
/*
 * Copyright (c) 2022 Meta
 *
 * SPDX-License-Identifier: Apache-2.0
 */

#include "_common.h"

#ifdef CONFIG_POSIX_API
#include <semaphore.h>
#else
#include <zephyr/posix/semaphore.h>
#endif

/**
 * @brief existence test for `<semaphore.h>`
 *
 * @see <a href="https://pubs.opengroup.org/onlinepubs/9699919799/basedefs/semaphore.h.html">semaphore.h</a>
 */
ZTEST(posix_headers, test_semaphore_h)
{
	/* zassert_not_equal(SEM_FAILED, (sem_t *)42); */ /* not implemented */

	if (IS_ENABLED(CONFIG_POSIX_API)) {
		/* zassert_not_null(sem_close); */ /* not implemented */
		zassert_not_null(sem_destroy);
		zassert_not_null(sem_getvalue);
		zassert_not_null(sem_init);
		/* zassert_not_null(sem_open); */ /* not implemented */
		zassert_not_null(sem_post);
		zassert_not_null(sem_timedwait);
		zassert_not_null(sem_trywait);
		/* zassert_not_null(sem_unlink); */ /* not implemented */
		zassert_not_null(sem_wait);
	}
}
```

## src/signal_h.c
```c
/*
 * Copyright (c) 2022 Meta
 *
 * SPDX-License-Identifier: Apache-2.0
 */

#include "_common.h"

#ifdef CONFIG_POSIX_API
#include <signal.h>
#else
#include <zephyr/posix/signal.h>
#endif

/**
 * @brief existence test for `<signal.h>`
 *
 * @see <a href="https://pubs.opengroup.org/onlinepubs/9699919799/basedefs/signal.h.html">signal.h</a>
 */
ZTEST(posix_headers, test_signal_h)
{
	/* zassert_not_equal(-1, SIG_DFL); */ /* not implemented */
	/* zassert_not_equal(-1, SIG_ERR); */ /* not implemented */
	/* zassert_not_equal(-1, SIG_HOLD); */ /* not implemented */
	/* zassert_not_equal(-1, SIG_IGN); */ /* not implemented */

	/* zassert_not_equal((sig_atomic_t)-1, (sig_atomic_t)0); */ /* not implemented */
	/* zassert_not_equal((pid_t)-1, (pid_t)0); */ /* not implemented */

	zassert_not_equal(-1, offsetof(struct sigevent, sigev_notify));
	zassert_not_equal(-1, offsetof(struct sigevent, sigev_signo));
	zassert_not_equal(-1, offsetof(struct sigevent, sigev_value));
	zassert_not_equal(-1, offsetof(struct sigevent, sigev_notify_function));
	zassert_not_equal(-1, offsetof(struct sigevent, sigev_notify_attributes));

	zassert_not_equal(-1, SIGEV_NONE);
	zassert_not_equal(-1, SIGEV_SIGNAL);
	zassert_not_equal(-1, SIGEV_THREAD);

	zassert_not_equal(-1, offsetof(union sigval, sival_int));
	zassert_not_equal(-1, offsetof(union sigval, sival_ptr));

	/* zassert_not_equal(-1, RTSIG_MAX); */ /* not implemented */
	/* zassert_true(SIGRTMAX - SIGRTMIN >= RTSIG_MAX); */ /* not implemented */

	/* zassert_not_equal(-1, SIG_BLOCK); */ /* not implemented */
	/* zassert_not_equal(-1, SIG_UNBLOCK); */ /* not implemented */
	/* zassert_not_equal(-1, SIG_SETMASK); */ /* not implemented */

	/* zassert_not_equal(-1, SA_NOCLDSTOP); */ /* not implemented */
	/* zassert_not_equal(-1, SA_ONSTACK); */ /* not implemented */
	/* zassert_not_equal(-1, SA_RESETHAND); */ /* not implemented */
	/* zassert_not_equal(-1, SA_RESTART); */ /* not implemented */
	/* zassert_not_equal(-1, SA_SIGINFO); */ /* not implemented */
	/* zassert_not_equal(-1, SA_NOCLDWAIT); */ /* not implemented */
	/* zassert_not_equal(-1, SA_NODEFER); */ /* not implemented */

	/* zassert_not_equal(-1, SS_ONSTACK); */ /* not implemented */
	/* zassert_not_equal(-1, SS_DISABLE); */ /* not implemented */

	/* zassert_not_equal(-1, MINSIGSTKSZ); */ /* not implemented */
	/* zassert_not_equal(-1, SIGSTKSZ); */ /* not implemented */

	/* mcontext_t mctx = {0}; */ /* not implemented */

	/* zassert_not_equal(-1, offsetof(ucontext_t, uc_link)); */ /* not implemented */
	/* zassert_not_equal(-1, offsetof(ucontext_t, uc_sigmask)); */ /* not implemented */
	/* zassert_not_equal(-1, offsetof(ucontext_t, uc_stack)); */ /* not implemented */
	/* zassert_not_equal(-1, offsetof(ucontext_t, uc_mcontext)); */ /* not implemented */

	/* zassert_not_equal(-1, offsetof(stack_t, ss_sp)); */ /* not implemented */
	/* zassert_not_equal(-1, offsetof(stack_t, ss_size)); */ /* not implemented */
	/* zassert_not_equal(-1, offsetof(stack_t, ss_flags)); */ /* not implemented */

	/* zassert_not_equal(-1, offsetof(siginfo_t, si_signo)); */ /* not implemented */
	/* zassert_not_equal(-1, offsetof(siginfo_t, si_code)); */ /* not implemented */
	/* zassert_not_equal(-1, offsetof(siginfo_t, si_errno)); */ /* not implemented */
	/* zassert_not_equal(-1, offsetof(siginfo_t, si_pid)); */ /* not implemented */
	/* zassert_not_equal(-1, offsetof(siginfo_t, si_uid)); */ /* not implemented */
	/* zassert_not_equal(-1, offsetof(siginfo_t, si_addr)); */ /* not implemented */
	/* zassert_not_equal(-1, offsetof(siginfo_t, si_status)); */ /* not implemented */
	/* zassert_not_equal(-1, offsetof(siginfo_t, si_band)); */ /* not implemented */
	/* zassert_not_equal(-1, offsetof(siginfo_t, si_value)); */ /* not implemented */

	/* zassert_not_equal(-1, ILL_ILLOPC); */ /* not implemented */
	/* zassert_not_equal(-1, ILL_ILLOPN); */ /* not implemented */
	/* zassert_not_equal(-1, ILL_ILLADR); */ /* not implemented */
	/* zassert_not_equal(-1, ILL_ILLTRP); */ /* not implemented */
	/* zassert_not_equal(-1, ILL_PRVOPC); */ /* not implemented */
	/* zassert_not_equal(-1, ILL_PRVREG); */ /* not implemented */
	/* zassert_not_equal(-1, ILL_COPROC); */ /* not implemented */
	/* zassert_not_equal(-1, ILL_BADSTK); */ /* not implemented */

	/* zassert_not_equal(-1, FPE_INTDIV); */ /* not implemented */
	/* zassert_not_equal(-1, FPE_INTOVF); */ /* not implemented */
	/* zassert_not_equal(-1, FPE_FLTDIV); */ /* not implemented */
	/* zassert_not_equal(-1, FPE_FLTOVF); */ /* not implemented */
	/* zassert_not_equal(-1, FPE_FLTUND); */ /* not implemented */
	/* zassert_not_equal(-1, FPE_FLTRES); */ /* not implemented */
	/* zassert_not_equal(-1, FPE_FLTINV); */ /* not implemented */
	/* zassert_not_equal(-1, FPE_FLTSUB); */ /* not implemented */

	/* zassert_not_equal(-1, SEGV_MAPERR); */ /* not implemented */
	/* zassert_not_equal(-1, SEGV_ACCERR); */ /* not implemented */

	/* zassert_not_equal(-1, BUS_ADRALN); */ /* not implemented */
	/* zassert_not_equal(-1, BUS_ADRERR); */ /* not implemented */
	/* zassert_not_equal(-1, BUS_OBJERR); */ /* not implemented */

	/* zassert_not_equal(-1, TRAP_BRKPT); */ /* not implemented */
	/* zassert_not_equal(-1, TRAP_TRACE); */ /* not implemented */

	/* zassert_not_equal(-1, CLD_EXITED); */ /* not implemented */
	/* zassert_not_equal(-1, CLD_KILLED); */ /* not implemented */
	/* zassert_not_equal(-1, CLD_DUMPED); */ /* not implemented */
	/* zassert_not_equal(-1, CLD_TRAPPED); */ /* not implemented */
	/* zassert_not_equal(-1, CLD_STOPPED); */ /* not implemented */
	/* zassert_not_equal(-1, CLD_CONTINUED); */ /* not implemented */

	/* zassert_not_equal(-1, POLL_IN); */ /* not implemented */
	/* zassert_not_equal(-1, POLL_OUT); */ /* not implemented */
	/* zassert_not_equal(-1, POLL_MSG); */ /* not implemented */
	/* zassert_not_equal(-1, POLL_ERR); */ /* not implemented */
	/* zassert_not_equal(-1, POLL_PRI); */ /* not implemented */
	/* zassert_not_equal(-1, POLL_HUP); */ /* not implemented */

	/* zassert_not_equal(-1, SI_USER); */ /* not implemented */
	/* zassert_not_equal(-1, SI_QUEUE); */ /* not implemented */
	/* zassert_not_equal(-1, SI_TIMER); */ /* not implemented */
	/* zassert_not_equal(-1, SI_ASYNCIO); */ /* not implemented */
	/* zassert_not_equal(-1, SI_MESGQ); */ /* not implemented */

#ifdef CONFIG_POSIX_SIGNAL
	zassert_true(SIGRTMIN >= 0);
	zassert_true(SIGRTMAX >= SIGRTMIN);
	zassert_not_equal(-1, SIGABRT);
	zassert_not_equal(-1, SIGALRM);
	zassert_not_equal(-1, SIGBUS);
	zassert_not_equal(-1, SIGCHLD);
	zassert_not_equal(-1, SIGCONT);
	zassert_not_equal(-1, SIGFPE);
	zassert_not_equal(-1, SIGHUP);
	zassert_not_equal(-1, SIGILL);
	zassert_not_equal(-1, SIGINT);
	zassert_not_equal(-1, SIGKILL);
	zassert_not_equal(-1, SIGPIPE);
	zassert_not_equal(-1, SIGQUIT);
	zassert_not_equal(-1, SIGSEGV);
	zassert_not_equal(-1, SIGSTOP);
	zassert_not_equal(-1, SIGTERM);
	zassert_not_equal(-1, SIGTSTP);
	zassert_not_equal(-1, SIGTTIN);
	zassert_not_equal(-1, SIGTTOU);
	zassert_not_equal(-1, SIGUSR1);
	zassert_not_equal(-1, SIGUSR2);
	zassert_not_equal(-1, SIGTRAP);
	zassert_not_equal(-1, SIGURG);
	zassert_not_equal(-1, SIGXCPU);
	zassert_not_equal(-1, SIGXFSZ);
	zassert_not_equal(((sigset_t){.sig[0] = 0}).sig[0], ((sigset_t){.sig[0] = -1}).sig[0]);
	zassert_not_null(sigemptyset);
	zassert_not_null(sigfillset);
	zassert_not_null(sigaddset);
	zassert_not_null(sigdelset);
	zassert_not_null(sigismember);
	zassert_not_null(strsignal);
#endif /* CONFIG_POSIX_SIGNAL */

	if (IS_ENABLED(CONFIG_POSIX_API)) {
		/* zassert_not_null(kill); */ /* not implemented */
		/* zassert_not_null(killpg); */ /* not implemented */
		/* zassert_not_null(psiginfo); */ /* not implemented */
		/* zassert_not_null(psignal); */ /* not implemented */
		/* zassert_not_null(pthread_kill); */ /* not implemented */
		/* zassert_not_null(pthread_sigmask); */ /* not implemented */
		/* zassert_not_null(raise); */ /* not implemented */
		/* zassert_not_null(sigaction); */ /* not implemented */
		/* zassert_not_null(sigaltstack); */ /* not implemented */
		/* zassert_not_null(sighold); */ /* not implemented */
		/* zassert_not_null(sigignore); */ /* not implemented */
		/* zassert_not_null(siginterrupt); */ /* not implemented */
		/* zassert_not_null(signal); */ /* not implemented */
		/* zassert_not_null(sigpause); */ /* not implemented */
		/* zassert_not_null(sigpending); */ /* not implemented */
		/* zassert_not_null(sigprocmask); */ /* not implemented */
		/* zassert_not_null(sigqueue); */ /* not implemented */
		/* zassert_not_null(sigrelse); */ /* not implemented */
		/* zassert_not_null(sigset); */ /* not implemented */
		/* zassert_not_null(sigsuspend); */ /* not implemented */
		/* zassert_not_null(sigtimedwait); */ /* not implemented */
		/* zassert_not_null(sigwait); */ /* not implemented */
		/* zassert_not_null(sigwaitinfo); */ /* not implemented */
	}
}
```

## src/sys_select_h.c
```c
/*
 * Copyright (c) 2022 Meta
 *
 * SPDX-License-Identifier: Apache-2.0
 */

#include "_common.h"

#ifdef CONFIG_POSIX_API
#include <sys/select.h>
#else
#include <zephyr/posix/sys/select.h>
#endif

/**
 * @brief existence test for `<sys/select.h>`
 *
 * @see <a href="https://pubs.opengroup.org/onlinepubs/9699919799/basedefs/sys_select.h.html">sys/select.h</a>
 */
ZTEST(posix_headers, test_sys_select_h)
{
	fd_set fds = {0};

	zassert_not_equal(-1, FD_SETSIZE);
	FD_CLR(0, &fds);
	FD_ISSET(0, &fds);
	FD_SET(0, &fds);
	FD_ZERO(&fds);

	if (IS_ENABLED(CONFIG_POSIX_API)) {
		/* zassert_not_null(pselect); */ /* not implemented */
		zassert_not_null(select);
	}
}
```

## src/sys_socket_h.c
```c
/*
 * Copyright (c) 2022 Meta
 *
 * SPDX-License-Identifier: Apache-2.0
 */

#include "_common.h"

#ifdef CONFIG_POSIX_API
#include <sys/socket.h>
#else
#include <zephyr/posix/sys/socket.h>
#endif

#pragma GCC diagnostic push
#pragma GCC diagnostic ignored "-Wunused-value"
/**
 * @brief existence test for `<sys/socket.h>`
 *
 * @see <a href="https://pubs.opengroup.org/onlinepubs/9699919799/basedefs/sys_socket.h.html">sys/socket.h</a>
 */
ZTEST(posix_headers, test_sys_socket_h)
{
	struct cmsghdr cmsg = {0};
	struct msghdr mhdr = {0};

	zassert_true(sizeof(socklen_t) >= sizeof(uint32_t));
	zassert_true((sa_family_t)-1 >= 0);

	zassert_not_equal(-1, offsetof(struct sockaddr, sa_family));
	/*
	 * FIXME: in zephyr, we define struct sockaddr in <zephyr/net/net_ip.h>
	 * The sa_data field is defined (incorrectly) as data.
	 * Fixing that is a (possibly breaking) tree-wide change.
	 */
	/* zassert_not_equal(-1, offsetof(struct sockaddr, sa_data)); */ /* not implemented */

	zassert_not_equal(-1, offsetof(struct sockaddr_storage, ss_family));
	zassert_equal(offsetof(struct sockaddr, sa_family),
		      offsetof(struct sockaddr_storage, ss_family));

	zassert_not_equal(-1, offsetof(struct msghdr, msg_name));
	zassert_not_equal(-1, offsetof(struct msghdr, msg_namelen));
	zassert_not_equal(-1, offsetof(struct msghdr, msg_iov));
	zassert_not_equal(-1, offsetof(struct msghdr, msg_iovlen));
	zassert_not_equal(-1, offsetof(struct msghdr, msg_control));
	zassert_not_equal(-1, offsetof(struct msghdr, msg_controllen));
	zassert_not_equal(-1, offsetof(struct msghdr, msg_flags));

	zassert_not_equal(-1, offsetof(struct cmsghdr, cmsg_len));
	zassert_not_equal(-1, offsetof(struct cmsghdr, cmsg_level));
	zassert_not_equal(-1, offsetof(struct cmsghdr, cmsg_type));

	CMSG_DATA(&cmsg);
	CMSG_NXTHDR(&mhdr, &cmsg);
	CMSG_FIRSTHDR(&mhdr);

	zassert_not_equal(-1, offsetof(struct linger, l_onoff));
	zassert_not_equal(-1, offsetof(struct linger, l_linger));

	zassert_not_equal(-1, SOCK_DGRAM);
	zassert_not_equal(-1, SOCK_RAW);
	/* zassert_not_equal(-1, SOCK_SEQPACKET); */ /* not implemented */
	zassert_not_equal(-1, SOCK_STREAM);

	zassert_not_equal(-1, SO_ACCEPTCONN);
	zassert_not_equal(-1, SO_BROADCAST);
	zassert_not_equal(-1, SO_DEBUG);
	zassert_not_equal(-1, SO_DONTROUTE);
	zassert_not_equal(-1, SO_ERROR);
	zassert_not_equal(-1, SO_KEEPALIVE);
	zassert_not_equal(-1, SO_LINGER);
	zassert_not_equal(-1, SO_OOBINLINE);
	zassert_not_equal(-1, SO_RCVBUF);
	zassert_not_equal(-1, SO_RCVLOWAT);
	zassert_not_equal(-1, SO_RCVTIMEO);
	zassert_not_equal(-1, SO_REUSEADDR);
	zassert_not_equal(-1, SO_SNDBUF);
	zassert_not_equal(-1, SO_SNDLOWAT);
	zassert_not_equal(-1, SO_SNDTIMEO);
	zassert_not_equal(-1, SO_TYPE);

	zassert_not_equal(-1, SOMAXCONN);

	/* zassert_not_equal(-1, MSG_CTRUNC); */ /* not implemented */
	/* zassert_not_equal(-1, MSG_DONTROUTE); */ /* not implemented */
	/* zassert_not_equal(-1, MSG_EOR); */ /* not implemented */
	/* zassert_not_equal(-1, MSG_OOB); */ /* not implemented */
	/* zassert_not_equal(-1, MSG_NOSIGNAL); */ /* not implemented */
	zassert_not_equal(-1, MSG_PEEK);
	zassert_not_equal(-1, MSG_TRUNC);
	zassert_not_equal(-1, MSG_WAITALL);

	zassert_not_equal(-1, AF_INET);
	zassert_not_equal(-1, AF_INET6);
	zassert_not_equal(-1, AF_UNIX);
	zassert_not_equal(-1, AF_UNSPEC);

	zassert_not_equal(-1, SHUT_RD);
	zassert_not_equal(-1, SHUT_RDWR);
	zassert_not_equal(-1, SHUT_WR);

	if (IS_ENABLED(CONFIG_POSIX_API)) {
		zassert_not_null(accept);
		zassert_not_null(bind);
		zassert_not_null(connect);
		zassert_not_null(getpeername);
		zassert_not_null(getsockname);
		zassert_not_null(listen);
		zassert_not_null(recv);
		zassert_not_null(recvfrom);
		/* zassert_not_null(recvmsg); */ /* not implemented */
		zassert_not_null(send);
		zassert_not_null(sendmsg);
		zassert_not_null(sendto);
		zassert_not_null(setsockopt);
		zassert_not_null(shutdown);
		/* zassert_not_null(sockatmark); */ /* not implemented */
		zassert_not_null(socket);
		zassert_not_null(socketpair);
	}
}
#pragma GCC diagnostic pop
```
