## CMakeLists.txt
```
# SPDX-License-Identifier: Apache-2.0

cmake_minimum_required(VERSION 3.20.0)

# The default board for this example is the nrf52840dk_nrf52840, but can be
# overridden by passing --board=<board> to west or -DBOARD=<board> to cmake
set(BOARD nrf52840dk_nrf52840)

find_package(Zephyr REQUIRED HINTS $ENV{ZEPHYR_BASE})
project(fs_shell)

FILE(GLOB app_sources src/*.c)
target_sources(app PRIVATE ${app_sources})

zephyr_include_directories(config)

# Normalize dbug + __FILE__ paths to relative locations:
# 1. west workspace
# 2. toolchain install location (applies to paths in cross tool library files)
#
# If debugging from location 1., the west-manifest files should already have the
# correct relative path for GDB to locate them, otherwise the GDB "directory"
# command can be used to tell GDB where to find the source files (also required
# if the cross tool libraries/headers need to be located by GDB)
get_filename_component(WEST_PROJECT_ROOT_PATH
                       "${CMAKE_CURRENT_LIST_DIR}/.."
                       ABSOLUTE)
zephyr_compile_options(
    -ffile-prefix-map=${WEST_PROJECT_ROOT_PATH}=.
    -ffile-prefix-map=${TOOLCHAIN_HOME}=.
    -Wa,--debug-prefix-map=${WEST_PROJECT_ROOT_PATH}=.
)
```

## Kconfig
```
menu "MEMFAULT_APP"

# Set Memfault fw_version to the same as the mcuboot image version
config MEMFAULT_NCS_FW_VERSION
    default MCUBOOT_IMAGE_VERSION

config MEMFAULT_APP_CAPTURE_ALL_RAM
    bool "Capture all RAM"
    help
      Capture all RAM regions. This is useful for debugging purposes, but
      will increase the amount of data captured by the Memfault SDK.

# If MEMFAULT_APP_CAPTURE_ALL_RAM is enabled, increase the configured space
# for the Memfault storage partition to accommodate the larger coredump.
#
# This overrides the default setting, which can be found here:
# https://github.com/nrfconnect/sdk-nrf/blob/96f97684565fbf711f1ceb7da061fed0bfe7b60b/modules/memfault-firmware-sdk/Kconfig#L170-L172
#
# Expanded into the template here:
# https://github.com/nrfconnect/sdk-nrf/blob/96f97684565fbf711f1ceb7da061fed0bfe7b60b/subsys/partition_manager/Kconfig.template.partition_size
#
# Keep 'source "Kconfig.zephyr"' at the end of this file so this default takes
# precendence.
config PM_PARTITION_SIZE_MEMFAULT_STORAGE
    hex "Size of the Memfault storage partition"
    # The default size is set to one page above the total RAM size on the
    # NRF52840 SOC, which provides room for the coredump header and NVIC and CPU
    # registers. This size needs to be flash page-aligned ("minimum eraseable
    # unit").
    default 0x41000 if MEMFAULT_APP_CAPTURE_ALL_RAM

endmenu

source "Kconfig.zephyr"
```

## sample.yaml
```
sample:
  description: Memfault SDK example integration built on top of the Zephyr FS
    shell sample app, with the nRF Connect SDK
  name: Memfault Demo App
```

## west.yml
```
manifest:
  remotes:
    - name: nrf-connect-sdk
      url-base: https://github.com/nrfconnect
  projects:
    - name: nrf
      url: https://github.com/nrfconnect/sdk-nrf
      revision: v2.4.2
      import: true

    # Adding the memfault-firmware-sdk module here overrides the version the nRF
    # Connect SDK would normally import above
    - name: memfault-firmware-sdk
      url: https://github.com/memfault/memfault-firmware-sdk
      path: modules/lib/memfault-firmware-sdk
      revision: master
  self:
    path: memfault_demo_app
```

## prj.conf
```kconfig
CONFIG_HEAP_MEM_POOL_SIZE=16384
CONFIG_MAIN_STACK_SIZE=4096

CONFIG_SHELL=y
CONFIG_SHELL_LOG_LEVEL_INF=y

# hwinfo is used to get a unique device id from the chip id
CONFIG_HWINFO=y

# Enable Memfault
CONFIG_MEMFAULT=y

# Use internal flash to store the coredump
CONFIG_MEMFAULT_NCS_INTERNAL_FLASH_BACKED_COREDUMP=y

# set a dummy project key; this setting is required by the nrf-connect
# integration, but it is unused in a non-HTTP application
CONFIG_MEMFAULT_NCS_PROJECT_KEY="xxxxxxxxxxxxxxxxxxxxxxxxxxxxxxxx"

# Set device information fields
CONFIG_MEMFAULT_NCS_DEVICE_ID_RUNTIME=y
CONFIG_MEMFAULT_NCS_HW_VERSION="a"
CONFIG_MEMFAULT_NCS_FW_TYPE="nrf52_example"
CONFIG_MEMFAULT_NCS_FW_VERSION_STATIC=y
# Note: MEMFAULT_NCS_FW_VERSION is set from this in the project Kconfig
CONFIG_MCUBOOT_IMAGE_VERSION="0.0.1"

# Enable and configure logging
CONFIG_LOG=y
CONFIG_LOG_BACKEND_UART=y
# Disable the shell log backend. Rely on the configured backend instead (RTT,
# UART, etc.)
CONFIG_SHELL_LOG_BACKEND=n
# Immediate logging is more performant at the expense of the rest of the system.
# Default is deferred to the logging thread.
CONFIG_LOG_MODE_IMMEDIATE=y
# Enable DBG log level
CONFIG_MEMFAULT_LOG_LEVEL_DBG=y
# Disable logging of printk, to improve 'mflt export' performance under deferred
# logging mode.
CONFIG_LOG_PRINTK=n

# Enable capture of recent logs as part of a coredump
CONFIG_MEMFAULT_LOGGING_ENABLE=y

# Enable Flash and Bootloader components for for flash-backed coredump storage
CONFIG_BOOTLOADER_MCUBOOT=y
CONFIG_MCUBOOT_IMG_MANAGER=y
CONFIG_IMG_MANAGER=y
CONFIG_FLASH=y
CONFIG_FLASH_MAP=y
CONFIG_STREAM_FLASH=y

CONFIG_WATCHDOG=y

# Enable Zephyr runtime asserts
CONFIG_ASSERT=y
```

## 1mbaud_uart.overlay
```dts
/* gotta go fast 🐎 */
&uart0 {
	current-speed = <1000000>;
};
```

## src/main.c
```c
//! @file
//!
//! Copyright (c) Memfault, Inc.
//! See License.txt for details
//!
//! Example console main

// clang-format off
#include "memfault/ports/zephyr/include_compatibility.h"

#include MEMFAULT_ZEPHYR_INCLUDE(drivers/hwinfo.h)
#include MEMFAULT_ZEPHYR_INCLUDE(logging/log.h)
#include <memfault/components.h>
#include <memfault_ncs.h>
#include <stdio.h>

#include "memfault/ports/watchdog.h"
// clang-format on

LOG_MODULE_REGISTER(main, LOG_LEVEL_INF);

//! wrapper to enclose logic around log_strdup
char *prv_conditional_log_strdup(char *str) {
#if !MEMFAULT_ZEPHYR_VERSION_GT(3, 1)
  #if defined(CONFIG_LOG) && !defined(CONFIG_LOG2)
  // Before zephyr 3.1, LOG was a different option from LOG2 and required
  // manually duplicating string argument values. Only required if CONFIG_LOG is
  // in use.
  return log_strdup(str);
  #endif
#endif

  return str;
}

static void prv_set_device_id(void) {
  uint8_t dev_id[16] = {0};
  char dev_id_str[sizeof(dev_id) * 2 + 1];
  char *dev_str = "UNKNOWN";

  // Obtain the device id
  ssize_t length = hwinfo_get_device_id(dev_id, sizeof(dev_id));

  // If this fails for some reason, use a fixed ID instead
  if (length <= 0) {
    dev_str = CONFIG_SOC_SERIES "-test";
    length = strlen(dev_str);
  } else {
    // Render the obtained serial number in hexadecimal representation
    for (size_t i = 0; i < length; i++) {
      (void)snprintf(&dev_id_str[i * 2], sizeof(dev_id_str), "%02x", dev_id[i]);
    }
    dev_str = dev_id_str;
  }

  LOG_INF("Device ID: %s", prv_conditional_log_strdup(dev_str));

  memfault_ncs_device_id_set(dev_str, length * 2);
}

#if CONFIG_MEMFAULT_APP_CAPTURE_ALL_RAM
// capture *ALL* of ram
const sMfltCoredumpRegion *memfault_platform_coredump_get_regions(
  const sCoredumpCrashInfo *crash_info, size_t *num_regions) {
  static sMfltCoredumpRegion s_regions[] = {
    MEMFAULT_COREDUMP_MEMORY_REGION_INIT(CONFIG_PM_SRAM_BASE, CONFIG_PM_SRAM_SIZE),
  };
  *num_regions = ARRAY_SIZE(s_regions);
  return s_regions;
}
#endif  // CONFIG_MEMFAULT_APP_CAPTURE_ALL_RAM

#define WD_FEED_THREAD_STACK_SIZE 500
// set priority to lowest application thread; shell_uart, where the 'mflt test
// hang' command runs from, uses the same priority by default, so this should
// not preempt it and correctly trip the watchdog
#if CONFIG_SHELL_THREAD_PRIORITY_OVERRIDE
  #error "Watchdog feed thread priority must be lower than shell thread priority"
#endif
#define WD_FEED_THREAD_PRIORITY K_LOWEST_APPLICATION_THREAD_PRIO

static void prv_wd_feed_thread_function(void *arg0, void *arg1, void *arg2) {
  ARG_UNUSED(arg0);
  ARG_UNUSED(arg1);
  ARG_UNUSED(arg2);

  while (1) {
    memfault_software_watchdog_feed();
    k_sleep(K_SECONDS(1));
  }
}
K_THREAD_DEFINE(wd_feed_thread, WD_FEED_THREAD_STACK_SIZE, prv_wd_feed_thread_function, NULL, NULL,
                NULL, WD_FEED_THREAD_PRIORITY, 0, 0);

static void prv_start_watchdog_feed_thread(void) {
  LOG_INF("starting watchdog feed thread 🐶");
  memfault_software_watchdog_enable();
  k_thread_name_set(wd_feed_thread, "wd_feed_thread");
  k_thread_start(wd_feed_thread);
}

int main(void) {
  LOG_INF("Booting Memfault sample app!");

  // Set the device id based on the hardware UID
  prv_set_device_id();

  memfault_device_info_dump();

  prv_start_watchdog_feed_thread();

  return 0;
}
```
