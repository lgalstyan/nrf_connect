## CMakeLists.txt
```
# SPDX-License-Identifier: Apache-2.0

cmake_minimum_required(VERSION 3.13.1)

if(DEFINED ENV{MEMFAULT_ZEPHYR_EXTRA_MODULE_INCLUDE})
  list(APPEND ZEPHYR_EXTRA_MODULES $ENV{ZEPHYR_BASE}/../modules/memfault-firmware-sdk/ports)
endif()

# Starting in nRF Connect SDK >= 1.3, versions are exposed in
# a CMake package:
#   https://github.com/nrfconnect/sdk-nrf/blob/master/share/ncs-package/cmake/NcsConfig.cmake
#
# We can pre-load the package before Zephyr to dynamically change Kconfig options based on version
# which is not something that can be achieved with Zephyr today
find_package(Ncs HINTS $ENV{ZEPHYR_BASE}/../nrf)

if (NOT NCS_VERSION_MAJOR)
  # Note: If we cannot resolve the NCS version, assume we are using 1.2.x which is the oldest
  # version Memfault has been tested against
  set(NCS_VERSION_MAJOR 1)
  set(NCS_VERSION_MINOR 2)
  set(NCS_VERSION_PATCH 0)
endif()

# Below we conditionally set Kconfig variables based on nRF Connect SDK version
# (since setting non-existent variables result in a build time error which
# would break compiling older builds)
#
# Zephyrs Kconfig extension pulls variables via the "CMake variable cache"
# so we set the ones we need here using that:
#   https://docs.zephyrproject.org/latest/build/kconfig/setting.html#the-initial-configuration

if (${NCS_VERSION_MAJOR}.${NCS_VERSION_MINOR}.${NCS_VERSION_PATCH} VERSION_LESS 1.3)
else() # nRF Connect SDK Version >= 1.3.0
  # We cannot set for NCS <= 1.2 because on older versions of zephyr the argument was not
  # directly user-configurable (no prompt in Kconfig)
  set(CONFIG_SHELL_LOG_BACKEND n CACHE INTERNAL "")
endif()

if (${NCS_VERSION_MAJOR}.${NCS_VERSION_MINOR}.${NCS_VERSION_PATCH} VERSION_LESS 1.5)
  # Legacy name for CONFIG_DEBUG_THREAD_INFO needed for nRF Connect version <= 1.5
  # due to the version of Zephyr included (pre v2.5)
  set(CONFIG_OPENOCD_SUPPORT y CACHE INTERNAL "")
else() # nRF Connect SDK Version >= 1.5.0
  # Enable Memfault FOTA Support
  #
  # We enable conditionally because prior to NCS < 1.5 a small patch (https://mflt.io/nrf-fota) was
  # needed in order for things to work
  set(CONFIG_MEMFAULT_FOTA y CACHE INTERNAL "")
  set(CONFIG_DOWNLOAD_CLIENT_MAX_FILENAME_SIZE 400 CACHE INTERNAL "")
  set(CONFIG_DOWNLOAD_CLIENT_STACK_SIZE 1600 CACHE INTERNAL "")

  # Note: Can optionally be changed to =y to implement
  # a custom event handler for FOTA events
  # CONFIG_MEMFAULT_FOTA_DOWNLOAD_CALLBACK_CUSTOM=n
endif()


if (${NCS_VERSION_MAJOR}.${NCS_VERSION_MINOR}.${NCS_VERSION_PATCH} VERSION_LESS 1.6.0)
  # Required for logging to work from crash but deprecated in Zephyr included in NCS 1.6
  set(CONFIG_LOG_IMMEDIATE y CACHE INTERNAL "")

  # NCS 1.6 was the first one which introduced setting the project key via
  # Kconfig. Look for this argument and remap to a regular compiler definition
  # that gets picked up in memfault_demo_app/src/main.c
  if (CONFIG_MEMFAULT_NCS_PROJECT_KEY)
    add_compile_definitions(MEMFAULT_NCS_PROJECT_KEY=${CONFIG_MEMFAULT_NCS_PROJECT_KEY})
    unset(CONFIG_MEMFAULT_NCS_PROJECT_KEY CACHE)
  endif()
else() # nRF Connect SDK Version >= 1.6.0
  set(CONFIG_MEMFAULT_NCS_PROVISION_CERTIFICATES n CACHE INTERNAL "")
  set(CONFIG_MEMFAULT_NCS_DEVICE_ID_RUNTIME y CACHE INTERNAL "")
  set(CONFIG_NEWLIB_LIBC y CACHE INTERNAL "")
endif()

if (${NCS_VERSION_MAJOR}.${NCS_VERSION_MINOR}.${NCS_VERSION_PATCH} VERSION_LESS 1.7.99)
  # These were removed in NCS 1.8.0, but are needed prior to that. Enable them
  # if NCS version <1.7.99 (.99 patch version is used for the next revision's
  # development series)
  set(CONFIG_BSD_LIBRARY y CACHE INTERNAL "")
  set(CONFIG_BSD_LIBRARY_SYS_INIT n CACHE INTERNAL "")
  # ^ Note: CONFIG_BSD_ were renamed to _NRF_MODEM_ in
  # nRF Connect SDK v1.5. We use the legacy names here
  # so the app can continue to compile on older targets
  #
  # CONFIG_NRF_MODEM_LIB
  # CONFIG_NRF_MODEM_LIB_SYS_INIT

  # For nRF Connect SDK v1.5 default value changed here
  set(CONFIG_AT_CMD_SYS_INIT n CACHE INTERNAL "")
else() # nRF Connect SDK Version >= 1.8.0
  # in v1.8+, use the modem_info library to get the IMEI for device_serial
  set(CONFIG_MODEM_INFO y CACHE INTERNAL "")

  # pre-2.3.0, SPM (Secure Partition Manager) can be used instead of the default
  # TFM, and results in nicer backtraces in certain cases, so select it here.
  if (${NCS_VERSION_MAJOR}.${NCS_VERSION_MINOR}.${NCS_VERSION_PATCH} VERSION_LESS 2.2.99)
    # Use SPM instead of TFM for Secure Firmware as TFM does not (yet) support forwarding of fault handlers
    set(CONFIG_BUILD_WITH_TFM n CACHE INTERNAL "")
    # Explicitly set SPM=y because as of nRF Connect >= 2.1.0 it is marked as deprecated and no longer enabled by default
    set(CONFIG_SPM y CACHE INTERNAL "")
  endif()
endif()

if (${NCS_VERSION_MAJOR}.${NCS_VERSION_MINOR}.${NCS_VERSION_PATCH} GREATER_EQUAL 2.4.0)
  # In Zephyr v3.4 release, FLASH_MAP and STREAM_FLASH must be specified manually
  #  https://github.com/zephyrproject-rtos/zephyr/commit/c3bfe7a6baf7e47d8ad70e38ffdea313f3ec62ce
  #
  # These are required for NCS >= 2.4
  set(CONFIG_FLASH_MAP y CACHE INTERNAL "")
  set(CONFIG_STREAM_FLASH y CACHE INTERNAL "")
endif()

# Required for app to compile against nRF Connect SDK <= v1.2
# Must be included after updating Kconfig settings in CMake Cache above
if(DEFINED ENV{MEMFAULT_INCLUDE_ZEPHYR_BOILERPLATE})
  include($ENV{ZEPHYR_BASE}/cmake/app/boilerplate.cmake NO_POLICY_SCOPE)
  include($ENV{ZEPHYR_BASE}/../nrf/cmake/boilerplate.cmake)
endif()

find_package(Zephyr HINTS $ENV{ZEPHYR_BASE})
project(hello_world)

target_sources(app PRIVATE src/main.c)
target_sources(app PRIVATE src/watchdog.c)
zephyr_include_directories(config)
```

## west.yml
```
manifest:
  projects:
    - name: nrf
      url: https://github.com/nrfconnect/sdk-nrf
      revision: v2.2.0
      import: true
      import:
        path-blocklist: modules/lib/memfault-firmware-sdk
    - name: memfault-firmware-sdk
      url: https://github.com/memfault/memfault-firmware-sdk
      path: modules/lib/memfault-firmware-sdk
      revision: master
  self:
    path: memfault_demo_app
    import: submanifests
```

## prj.conf
```kconfig
# project specific configuration settings


CONFIG_NETWORKING=y
CONFIG_NET_SOCKETS=y
CONFIG_NET_SOCKETS_POSIX_NAMES=y
CONFIG_NET_NATIVE=n

CONFIG_HEAP_MEM_POOL_SIZE=4096
CONFIG_MAIN_STACK_SIZE=4096

CONFIG_MODEM_KEY_MGMT=y
CONFIG_LTE_LINK_CONTROL=y

CONFIG_SHELL=y
CONFIG_SHELL_BACKEND_SERIAL=y

CONFIG_NET_LOG=y

CONFIG_NET_SOCKETS_OFFLOAD=y
CONFIG_MEMFAULT=y
CONFIG_MEMFAULT_NRF_CONNECT_SDK=y
CONFIG_MEMFAULT_ROOT_CERT_STORAGE_NRF9160_MODEM=y
CONFIG_MEMFAULT_HTTP_ENABLE=y
CONFIG_MEMFAULT_HTTP_PERIODIC_UPLOAD=y

# Required for logging backends to work as expected
CONFIG_LOG=y
CONFIG_LOG_BACKEND_UART=y

# Enable capture of recent logs as part of a coredump
CONFIG_MEMFAULT_LOGGING_ENABLE=y

# Disable logging of printk, to improve 'mflt export' performance under deferred
# logging mode.
CONFIG_LOG_PRINTK=n

# Enable Bootloader so OTA updates can be performed
CONFIG_BOOTLOADER_MCUBOOT=y
CONFIG_MCUBOOT_IMG_MANAGER=y

# The subsystems we need so OTA payloads can be written to
# flash and updated by MCUBoot
CONFIG_DFU_TARGET=y
CONFIG_DFU_TARGET_MCUBOOT=y
CONFIG_IMG_MANAGER=y
CONFIG_FLASH=y
CONFIG_IMG_ERASE_PROGRESSIVELY=y
# NB: CONFIG_FLASH_MAP=y & CONFIG_STREAM_FLASH=y are required for v2.4 and set dynamically in
# ./CMakeLists.txt

# For Memfault FOTA, we will use the FOTA_DOWNLOAD API's
# from the nRF Connect SDK which depends on the DOWNLOAD_CLIENT
CONFIG_FOTA_DOWNLOAD=y
CONFIG_DOWNLOAD_CLIENT=y

# Enable printing of file download progress to console
CONFIG_FOTA_DOWNLOAD_PROGRESS_EVT=y

# For nRF Connect SDK's prior to v1.4
CONFIG_MEMFAULT_HTTP_MAX_POST_SIZE=256

# Manually bring up LTE stack
CONFIG_LTE_AUTO_INIT_AND_CONNECT=n

CONFIG_WATCHDOG=y

# Enable Zephyr runtime asserts
CONFIG_ASSERT=y

# Enable littlefs on intern al flash, to demo the file system utilization metric
CONFIG_FILE_SYSTEM=y
CONFIG_FILE_SYSTEM_LITTLEFS=y
CONFIG_FILE_SYSTEM_SHELL=y

# Note: See ./CMakeLists.txt for additional Kconfig variables settings as not all variables can be
# set in a single prj.conf for backward compatibility with older versions of the nRF Connect SDK /
# Zephyr
```

## boards/nrf9160dk_nrf9160_ns_0_14_0.overlay
```dts
/* Device Tree overlay to enable auto-mounting littlefs in an internal
   partition, via the Nordic Partition Manager system */

/ {
	fstab {
		compatible = "zephyr,fstab";
		lfs1: lfs1 {
			compatible = "zephyr,fstab,littlefs";
			mount-point = "/lfs1";
			partition = <&storage_partition>;
			automount;
			read-size = <16>;
			prog-size = <16>;
			cache-size = <64>;
			lookahead-size = <32>;
			block-cycles = <512>;
		};
	};
};
```

## src/main.c
```c
//! @file
//!
//! Copyright (c) Memfault, Inc.
//! See License.txt for details
//!
//! Entry point to Memfault Radio. In this file you will find:
//!  1. Implementation for memfault_platform_get_device_info()
//!  2. g_mflt_http_client_config dependency which needs to be filled in with your Project Key
//!  3. A call to install the Root Certs used by Memfault on the nRF91 modem
//!     (memfault_nrfconnect_port_install_root_certs())
//!  4. Start of the LTE modem & AT interface

// clang-format off
#include "memfault/ports/zephyr/include_compatibility.h"

#include MEMFAULT_ZEPHYR_INCLUDE(device.h)
#include MEMFAULT_ZEPHYR_INCLUDE(kernel.h)
#include MEMFAULT_ZEPHYR_INCLUDE(sys/printk.h)
#include <string.h>

#include "memfault/core/build_info.h"
#include "memfault/core/compiler.h"
#include "memfault/core/math.h"
#include "memfault/core/platform/device_info.h"
#include "memfault/http/http_client.h"
#include "memfault/nrfconnect_port/http.h"
#include "memfault/ports/ncs/version.h"
#include "memfault_demo_app.h"

// nRF Connect SDK < 1.3
#if (NCS_VERSION_MAJOR == 1) && (NCS_VERSION_MINOR < 3)

#include <lte_lc.h>
#include <at_cmd.h>
#include <at_notif.h>
#include <modem_key_mgmt.h>
#include <net/bsdlib.h>
#include <modem_info.h>

// nRF Connect SDK < 1.9
#elif (NCS_VERSION_MAJOR == 1) && (NCS_VERSION_MINOR < 9) && (NCS_PATCHLEVEL < 99)

#include <modem/lte_lc.h>
#include <modem/at_cmd.h>
#include <modem/at_notif.h>
#include <modem/modem_key_mgmt.h>
#include <modem/modem_info.h>

// nRF Connect SDK >= 1.9
#else
#include <modem/modem_info.h>
#include <modem/lte_lc.h>
#include <nrf_modem_at.h>

#endif

#if (NCS_VERSION_MAJOR == 1) && (NCS_VERSION_MINOR <= 2)
#include <net/bsdlib.h>
static int prv_init_modem_lib(void) {
  return bsdlib_init();
}
#elif (NCS_VERSION_MAJOR == 1) && (NCS_VERSION_MINOR <= 4)
#include <modem/bsdlib.h>
static int prv_init_modem_lib(void) {
  return bsdlib_init();
}
#elif (NCS_VERSION_MAJOR == 1) && (NCS_VERSION_MINOR <= 5)
#include <modem/nrf_modem_lib.h>
static int prv_init_modem_lib(void) {
  return nrf_modem_lib_init(NORMAL_MODE);
}
#elif !MEMFAULT_NCS_VERSION_GT(2, 3)
/* nRF Connect SDK >= 1.6 || <= 2.3 */
#include "memfault_ncs.h"
#include <modem/nrf_modem_lib.h>
static int prv_init_modem_lib(void) {
  return nrf_modem_lib_init(NORMAL_MODE);
}
#else /* nRF Connect SDK >= 2.4 */
#include "memfault_ncs.h"
#include <modem/nrf_modem_lib.h>
static int prv_init_modem_lib(void) {
  return nrf_modem_lib_init();
}
#endif

#if CONFIG_DFU_TARGET_MCUBOOT
#include MEMFAULT_ZEPHYR_INCLUDE(dfu/mcuboot.h)
#endif
// clang-format on

// Since the example app manages when the modem starts/stops, we manually configure the device
// serial even when using nRF Connect SDKs including the Memfault integration (by using
// CONFIG_MEMFAULT_NCS_DEVICE_ID_RUNTIME)
#define IMEI_LEN 15
static char s_device_serial[IMEI_LEN + 1 /* '\0' */] = "unknown";

// A direct Memfault integration was added in 1.6
#if (NCS_VERSION_MAJOR == 1) && (NCS_VERSION_MINOR < 6)

// Note: Starting with nRF Connect SDK 1.6, there is a direct integration of Memfault
// and these dependencies are no longer needed!
// See https://mflt.io/nrf-connect-sdk-lib for more details

static char s_fw_version[16] = "1.0.0-dev";

#ifndef MEMFAULT_NCS_PROJECT_KEY
#define MEMFAULT_NCS_PROJECT_KEY "<YOUR PROJECT KEY HERE>"
#endif

sMfltHttpClientConfig g_mflt_http_client_config = {
  .api_key = MEMFAULT_NCS_PROJECT_KEY,
};

void memfault_platform_get_device_info(sMemfaultDeviceInfo *info) {
  // platform specific version information
  *info = (sMemfaultDeviceInfo) {
    .device_serial = s_device_serial,
    .software_type = "nrf91ns-fw",
    .software_version = s_fw_version,
    .hardware_version = "nrf9160dk",
  };
}

// stub for function implemented in nRF Connect SDK >= 1.6
static int memfault_ncs_device_id_set(const char *device_id, size_t len) {
  return 0;
}

#endif

#if !MEMFAULT_NCS_VERSION_GT(1, 8)
static int query_modem(const char *cmd, char *buf, size_t buf_len) {
  enum at_cmd_state at_state;
  int ret = at_cmd_write(cmd, buf, buf_len, &at_state);
  if (ret != 0) {
    printk("at_cmd_write [%s] error: %d, at_state: %d\n", cmd, ret, at_state);
  }

  return ret;
}
#endif

static int prv_get_imei(char *buf, size_t buf_len) {
#if MEMFAULT_NCS_VERSION_GT(1, 8)
  // use the cached modem info to fetch the IMEI
  int err = modem_info_init();
  if (err != 0) {
    printk("Modem info Init error: %d\n", err);
  } else {
    modem_info_string_get(MODEM_INFO_IMEI, buf, buf_len);
  }
  return err;
#else
  // use an AT command to read IMEI
  return query_modem("AT+CGSN", buf, buf_len);
#endif
}

static void prv_init_device_info(void) {
  // we'll use the IMEI as the device serial
  char modem_info[MODEM_INFO_MAX_RESPONSE_SIZE];

  int ret = prv_get_imei(modem_info, sizeof(modem_info));
  if (ret != 0) {
    printk("Failed to get IMEI\n\r");
  } else {
    modem_info[IMEI_LEN] = '\0';
    strcpy(s_device_serial, modem_info);
    printk("IMEI: %s\n", s_device_serial);
  }

  // register the device id with memfault port so it is used for reporting
  memfault_ncs_device_id_set(s_device_serial, IMEI_LEN);
}

int main(void) {
  printk("Memfault Demo App Started!\n");

  memfault_demo_app_watchdog_boot();

#if CONFIG_DFU_TARGET_MCUBOOT
  if (!boot_is_img_confirmed()) {
    // Mark the ota image as installed so we don't revert
    printk("Confirming OTA update\n");
    boot_write_img_confirmed();
  }
#endif

  int err = prv_init_modem_lib();
  if (err) {
    printk("Failed to initialize modem!");
    goto cleanup;
  }

  // These libraries were removed in ncs 1.9
#if !MEMFAULT_NCS_VERSION_GT(1, 8)
  err = at_cmd_init();
  if (err) {
    printk("Failed to initialize AT commands, err %d\n", err);
    goto cleanup;
  }

  err = at_notif_init();
  if (err) {
    printk("Failed to initialize AT notifications, err %d\n", err);
    goto cleanup;
  }
#endif

  // requires AT modem interface to be up
  prv_init_device_info();

  // Note: We must provision certs prior to connecting to the LTE network
  // in order to use them
  err = memfault_nrfconnect_port_install_root_certs();
  if (err) {
    goto cleanup;
  }

  printk("Waiting for network...\n");
  err = lte_lc_init_and_connect();
  if (err) {
    printk("Failed to connect to the LTE network, err %d\n", err);
    goto cleanup;
  }
  printk("OK\n");

cleanup:
  return err;
}
```

## src/watchdog.c
```c
//! @file
//!
//! Copyright (c) Memfault, Inc.
//! See License.txt for details
//!
//! Example configuration of Zephyr hardware watchdog with Memfault software watchdog
//! port such that a coredump is captured ahead of the hardware watchdog firing

// clang-format off
#include "memfault/ports/watchdog.h"

#include "memfault/ports/zephyr/include_compatibility.h"

#include MEMFAULT_ZEPHYR_INCLUDE(device.h)
#include MEMFAULT_ZEPHYR_INCLUDE(drivers/watchdog.h)
#include MEMFAULT_ZEPHYR_INCLUDE(kernel.h)
#include <version.h>

#include "memfault/components.h"
#include "memfault/ports/zephyr/version.h"
// clang-format on

//! Note: The timeout must be large enough to give us enough time to capture a coredump
//! before the system resets
#define MEMFAULT_WATCHDOG_HW_TIMEOUT_SECS (MEMFAULT_WATCHDOG_SW_TIMEOUT_SECS + 10)

#define WDT_MAX_WINDOW (MEMFAULT_WATCHDOG_HW_TIMEOUT_SECS * 1000)

#define WATCHDOG_TASK_STACK_SIZE 512
K_THREAD_STACK_DEFINE(s_wdt_task_stack_area, WATCHDOG_TASK_STACK_SIZE);
struct k_thread my_thread_data;

#if MEMFAULT_ZEPHYR_VERSION_GT(3,1)
// Between Zephyr 3.1 and 3.2, "label" properties in DTS started to get phased out:
//   https://github.com/zephyrproject-rtos/zephyr/pull/48360
//
// This breaks support for accessing device tree information via device_get_binding / DT_LABEL
// properties. The new preferred approach is accessing resources via the DEVICE_DT_GET macro
static const struct device *s_wdt = DEVICE_DT_GET(DT_NODELABEL(wdt));

#elif MEMFAULT_ZEPHYR_VERSION_GT(2,1)
static const struct device *s_wdt = NULL;
#else // Zephyr Kernel <= 2.1
static struct device *s_wdt = NULL;
#endif

#if KERNEL_VERSION_MAJOR == 2 && KERNEL_VERSION_MINOR < 3
  #define WDT_DEV_NAME DT_WDT_0_NAME
#else
  //! Watchdog device tree name changed in NCS v2.0.0 :
  //! https://github.com/nrfconnect/sdk-zephyr/blob/12ee4d5f4b99acef542ce3977cb9078fcbb36d82/dts/arm/nordic/nrf9160_common.dtsi#L368
  //! Pick the one that's available in the current SDK version.
  #if DT_HAS_COMPAT_STATUS_OKAY(nordic_nrf_wdt)
    #define WDT_NODE_NAME nordic_nrf_wdt
  #elif DT_HAS_COMPAT_STATUS_OKAY(nordic_nrf_watchdog)
    #define WDT_NODE_NAME nordic_nrf_watchdog
  #else
    #error "No compatible watchdog instance for this configuration!"
  #endif

  #define WDT_NODE DT_INST(0, WDT_NODE_NAME)
  #define WDT_DEV_NAME DT_LABEL(WDT_NODE)
#endif

static int s_wdt_channel_id = -1;

void memfault_demo_app_watchdog_feed(void) {
  if ((s_wdt == NULL) || (s_wdt_channel_id < 0)) {
    return;
  }

  wdt_feed(s_wdt, s_wdt_channel_id);
  memfault_software_watchdog_feed();
}

//! A basic watchdog implementation
//!
//! Once Zephyr has a Software & Task watchdog in place, the example will be updated to make use of
//! that For more info about watchdog setup in general, see https://mflt.io/root-cause-watchdogs
static void prv_wdt_task(void *arg1, void *arg2, void *arg3) {
  while (1) {
    k_sleep(K_SECONDS(1));

    memfault_demo_app_watchdog_feed();
  }
}

void memfault_demo_app_watchdog_boot(void) {
  MEMFAULT_LOG_DEBUG("Initializing WDT Subsystem");

#if MEMFAULT_ZEPHYR_VERSION_GT(3,1)
  if (!device_is_ready(s_wdt)) {
    printk("Watchdog device not ready");
    return;
  }
#else // Zephyr <= 3.1
  s_wdt = device_get_binding(WDT_DEV_NAME);
  if (s_wdt == NULL) {
    printk("No WDT device available\n");
    return;
  }
#endif

  struct wdt_timeout_cfg wdt_config = {
    /* Reset SoC when watchdog timer expires. */
    .flags = WDT_FLAG_RESET_SOC,

    /* Expire watchdog after max window */
    .window.min = 0U,
    .window.max = WDT_MAX_WINDOW,
  };

  s_wdt_channel_id = wdt_install_timeout(s_wdt, &wdt_config);
  if (s_wdt_channel_id < 0) {
    MEMFAULT_LOG_ERROR("Watchdog install error, rv=%d", s_wdt_channel_id);
    return;
  }

  const uint8_t options = WDT_OPT_PAUSE_HALTED_BY_DBG;
  int err = wdt_setup(s_wdt, options);
  if (err < 0) {
    MEMFAULT_LOG_ERROR("Watchdog setup error, rv=%d", err);
    return;
  }

  // start a low priority task that feeds the watchdog.
  // We make it the lowest priority so a hot loop in any task above will
  // cause the watchdog to not be fed
  memfault_software_watchdog_enable();
  k_thread_create(&my_thread_data, s_wdt_task_stack_area,
                  K_THREAD_STACK_SIZEOF(s_wdt_task_stack_area), prv_wdt_task, NULL, NULL, NULL,
                  K_LOWEST_APPLICATION_THREAD_PRIO, 0, K_NO_WAIT);
}
```
