## CMakeLists.txt
```
cmake_minimum_required(VERSION 3.13.1)

# The Zephyr port to target (i.e "v2.0", "v2.4")
if(NOT DEFINED ENV{MEMFAULT_ZEPHYR_PORT_TARGET})
  # Lar
  set(ENV{MEMFAULT_ZEPHYR_PORT_TARGET} v2.4)
endif()

# The path to the memfault-firmware-sdk
if(NOT DEFINED ENV{MEMFAULT_SDK_DIR})
  set(ENV{MEMFAULT_SDK_DIR} ${CMAKE_CURRENT_LIST_DIR}/../../../..)
endif()

# Add the memfault-firmware-sdk Zephyr port to the project
# NB: CONFIG_MEMFAULT=y will also need to be set in prj.conf to enable
set(MEMFAULT_ZEPHYR_PORT_TARGET $ENV{MEMFAULT_ZEPHYR_PORT_TARGET})
list(APPEND ZEPHYR_EXTRA_MODULES $ENV{MEMFAULT_SDK_DIR}/ports)

include($ENV{ZEPHYR_BASE}/cmake/app/boilerplate.cmake NO_POLICY_SCOPE)
project(memfault_demo_app)

zephyr_include_directories(config)
target_sources(app PRIVATE src/main.c)
```

## prj.conf
```kconfig
# General config
CONFIG_NEWLIB_LIBC=y

# Networking config
CONFIG_NETWORKING=y
CONFIG_NET_IPV4=y
CONFIG_NET_IPV6=y
CONFIG_NET_TCP=y
CONFIG_NET_SOCKETS=y
CONFIG_NET_SOCKETS_POSIX_NAMES=y

CONFIG_DNS_RESOLVER=y
CONFIG_DNS_SERVER_IP_ADDRESSES=y
CONFIG_DNS_SERVER1="8.8.8.8"

# Network debug config
CONFIG_NET_LOG=y

CONFIG_SHELL=y
# Networking Config:
CONFIG_NETWORKING=y
CONFIG_NET_IPV4=y
CONFIG_NET_IPV6=n
CONFIG_NET_SOCKETS=y

# Enable SimpleLink WiFi Driver and Socket Offload
CONFIG_WIFI=y
CONFIG_WIFI_LOG_LEVEL_ERR=y
CONFIG_NET_L2_WIFI_SHELL=y

# Options necessary to enable Mbed TLS logging. Useful for debugging low level TLS errors such as
# handshake & setup aborts
# CONFIG_MBEDTLS_DEBUG=y
# CONFIG_MBEDTLS_DEBUG_LEVEL=4
# CONFIG_NET_SOCKETS_LOG_LEVEL_DBG=y

# Required for logging backends to work as expected
CONFIG_LOG=y
CONFIG_LOG_PRINTK=y

# Debugging
CONFIG_NET_LOG=y
CONFIG_WIFI_LOG_LEVEL_DBG=n
CONFIG_DEBUG=y
CONFIG_ASSERT=y

CONFIG_SHELL_STACK_SIZE=4096
CONFIG_MAIN_STACK_SIZE=4096
CONFIG_MBEDTLS=y
CONFIG_MBEDTLS_BUILTIN=y
CONFIG_MBEDTLS_ENABLE_HEAP=y
CONFIG_MBEDTLS_HEAP_SIZE=34000
CONFIG_MBEDTLS_SSL_MAX_CONTENT_LEN=4096
CONFIG_NET_SOCKETS_SOCKOPT_TLS=y

# Disable socket offload because attempts to use eswifi socket offload
# hangs during setsockopt() calls
CONFIG_NET_SOCKETS_OFFLOAD=n

# Must match the number of certs being added with tls_credential_add
CONFIG_TLS_MAX_CREDENTIALS_NUMBER=5

# The maximum number of certs to be used when resolving root of trust on a socket
CONFIG_NET_SOCKETS_TLS_MAX_CREDENTIALS=5

CONFIG_MBEDTLS_USER_CONFIG_ENABLE=y
CONFIG_MBEDTLS_USER_CONFIG_FILE="memfault-mbedtls.conf"

CONFIG_REBOOT=y
CONFIG_INIT_STACKS=y
CONFIG_MPU_STACK_GUARD=y

# Memfault configuration
CONFIG_MEMFAULT=y
CONFIG_MEMFAULT_HTTP_ENABLE=y
# Use MBEDTLS for Memfault HTTP sockets
CONFIG_MEMFAULT_HTTP_USES_MBEDTLS=y
CONFIG_MEMFAULT_HTTP_PERIODIC_UPLOAD=y
CONFIG_MEMFAULT_HTTP_PERIODIC_UPLOAD_INTERVAL_SECS=60
CONFIG_MEMFAULT_LOGGING_ENABLE=y
CONFIG_MEMFAULT_LOGGING_RAM_SIZE=512

CONFIG_SYSTEM_WORKQUEUE_STACK_SIZE=4096
CONFIG_HEAP_MEM_POOL_SIZE=1024
```

## src/main.c
```c
//! @file
//!
//! Copyright (c) Memfault, Inc.
//! See License.txt for details

// clang-format off
#include "memfault/ports/zephyr/include_compatibility.h"

#include MEMFAULT_ZEPHYR_INCLUDE(kernel.h)
#include MEMFAULT_ZEPHYR_INCLUDE(logging/log.h)
#include <string.h>

#include "memfault/components.h"
#include "memfault/ports/zephyr/http.h"
// clang-format on

LOG_MODULE_REGISTER(mflt_app, LOG_LEVEL_DBG);

sMfltHttpClientConfig g_mflt_http_client_config = {
  .api_key = "<YOUR PROJECT KEY HERE>",
};

void memfault_platform_get_device_info(sMemfaultDeviceInfo *info) {
  *info = (sMemfaultDeviceInfo) {
    .device_serial = "DEMOSERIAL",
    .software_type = "zephyr-app",
    .software_version = "1.0.0-dev",
    .hardware_version = CONFIG_BOARD,
  };
}

int main(void) {
  LOG_INF("Memfault Demo App! Board %s\n", CONFIG_BOARD);
  memfault_device_info_dump();
  memfault_zephyr_port_install_root_certs();

  return 0;
}
```
